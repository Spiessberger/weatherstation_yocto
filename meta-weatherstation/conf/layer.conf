## meta-weatherstation/conf/layer.conf
```bitbake
BBPATH .= ":${LAYERDIR}"

BBFILES += "${LAYERDIR}/recipes-*/*/*.bb \
            ${LAYERDIR}/recipes-*/*/*.bbappend"

BBFILE_COLLECTIONS += "weatherstation"
BBFILE_PATTERN_weatherstation = "^${LAYERDIR}/"
BBFILE_PRIORITY_weatherstation = "10"

LAYERDEPENDS_weatherstation = "core raspberrypi networking-layer qt6-layer"
LAYERSERIES_COMPAT_weatherstation = "wrynose"
```
